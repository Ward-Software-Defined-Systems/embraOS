## buildroot/package/embra-embedding-model/Config.in
```kconfig
config BR2_PACKAGE_EMBRA_EMBEDDING_MODEL
	bool "embra-embedding-model"
	help
	  Sentence-embedding model installed read-only at
	  /usr/share/embra/models/<name>: an ONNX graph plus its
	  tokenizer, run in-process by embra-brain through tract for
	  knowledge-graph semantic retrieval (KG-02).

	  Default is BAAI/bge-small-en-v1.5 (MIT, 33.4M parameters,
	  384 dimensions, ~133 MB). Everything runs locally: no API
	  key, no per-query cost, no data leaves the instance, and
	  retrieval works with the network down.

	  Staged host-side by scripts/build-image.sh (Step 3.6) into
	  vendor/embedding-model, sha256-verified before staging. An
	  operator can override the baked copy per instance by seeding
	  /embra/state/models/<name> on STATE.

	  Without this package retrieval still works — it falls back to
	  lexical matching and /embeddings reports the model missing.
```

## buildroot/package/embra-firmware/Config.in
```kconfig
# Every family of linux-firmware in one symbol (Phase 2 wave 6, William's
# decision of 2026-11-08: the broad set, S1). The image loads no modules and
# a built-in driver asks for its blobs at probe or at open, so the blobs of
# every wired NIC, HBA, GPU and platform device the kernel fragments build
# are on the rootfs; post_build.sh copies the ones the mandatory drivers
# request at probe into /boot/firmware.cpio.gz, the initrd GRUB loads beside
# the initramfs, and the licence texts beside the binaries.
#
# The select list is generated from Buildroot's package/linux-firmware/
# Config.in:
#   sed -n 's/^config \(BR2_PACKAGE_LINUX_FIRMWARE_.*\)/\tselect \1/p' \
#       buildroot-src/package/linux-firmware/Config.in
# and the image build counts it against that file (assert_firmware_families
# in scripts/lib/image-common.sh): a Buildroot bump that adds a family stops
# the build until the list is regenerated.

config BR2_PACKAGE_EMBRA_FIRMWARE_ALL
	bool "embraOS: every linux-firmware family"
	select BR2_PACKAGE_LINUX_FIRMWARE
	select BR2_PACKAGE_LINUX_FIRMWARE_INTEL_SST_DSP
	select BR2_PACKAGE_LINUX_FIRMWARE_AMD_UCODE
	select BR2_PACKAGE_LINUX_FIRMWARE_AMDGPU
	select BR2_PACKAGE_LINUX_FIRMWARE_CDNS_MHDP8546
	select BR2_PACKAGE_LINUX_FIRMWARE_CNM_WAVE521C_K3_CODEC
	select BR2_PACKAGE_LINUX_FIRMWARE_I915
	select BR2_PACKAGE_LINUX_FIRMWARE_XE
	select BR2_PACKAGE_LINUX_FIRMWARE_RADEON
	select BR2_PACKAGE_LINUX_FIRMWARE_QCOM_VENUS
	select BR2_PACKAGE_LINUX_FIRMWARE_QCOM_ADRENO
	select BR2_PACKAGE_LINUX_FIRMWARE_MFC_V8
	select BR2_PACKAGE_LINUX_FIRMWARE_AMLOGIC
	select BR2_PACKAGE_LINUX_FIRMWARE_IBT
	select BR2_PACKAGE_LINUX_FIRMWARE_MEDIATEK_MT7650
	select BR2_PACKAGE_LINUX_FIRMWARE_MEDIATEK_MT7921_BT
	select BR2_PACKAGE_LINUX_FIRMWARE_MEDIATEK_MT7922_BT
	select BR2_PACKAGE_LINUX_FIRMWARE_MEDIATEK_MT7925_BT
	select BR2_PACKAGE_LINUX_FIRMWARE_QUALCOMM_6174A_BT
	select BR2_PACKAGE_LINUX_FIRMWARE_QUALCOMM_9377_BT
	select BR2_PACKAGE_LINUX_FIRMWARE_AR3011
	select BR2_PACKAGE_LINUX_FIRMWARE_AR3012_USB
	select BR2_PACKAGE_LINUX_FIRMWARE_RTL_87XX_BT
	select BR2_PACKAGE_LINUX_FIRMWARE_RTL_88XX_BT
	select BR2_PACKAGE_LINUX_FIRMWARE_TI_CC2560
	select BR2_PACKAGE_LINUX_FIRMWARE_ATHEROS_6002
	select BR2_PACKAGE_LINUX_FIRMWARE_ATHEROS_6003
	select BR2_PACKAGE_LINUX_FIRMWARE_ATHEROS_6004
	select BR2_PACKAGE_LINUX_FIRMWARE_ATHEROS_7010
	select BR2_PACKAGE_LINUX_FIRMWARE_ATHEROS_9170
	select BR2_PACKAGE_LINUX_FIRMWARE_ATHEROS_9271
	select BR2_PACKAGE_LINUX_FIRMWARE_ATHEROS_10K_QCA9377
	select BR2_PACKAGE_LINUX_FIRMWARE_ATHEROS_10K_QCA998X
	select BR2_PACKAGE_LINUX_FIRMWARE_BRCM_BCM43XX
	select BR2_PACKAGE_LINUX_FIRMWARE_BRCM_BCM43XXX
	select BR2_PACKAGE_LINUX_FIRMWARE_BRCM_BCM4366B1
	select BR2_PACKAGE_LINUX_FIRMWARE_BRCM_BCM4366C0
	select BR2_PACKAGE_LINUX_FIRMWARE_CYPRESS_CYW43XX
	select BR2_PACKAGE_LINUX_FIRMWARE_CYPRESS_CYW43XXX
	select BR2_PACKAGE_LINUX_FIRMWARE_CYPRESS_CYW54XXX
	select BR2_PACKAGE_LINUX_FIRMWARE_IWLWIFI_100
	select BR2_PACKAGE_LINUX_FIRMWARE_IWLWIFI_105
	select BR2_PACKAGE_LINUX_FIRMWARE_IWLWIFI_135
	select BR2_PACKAGE_LINUX_FIRMWARE_IWLWIFI_1000
	select BR2_PACKAGE_LINUX_FIRMWARE_IWLWIFI_2000
	select BR2_PACKAGE_LINUX_FIRMWARE_IWLWIFI_2030
	select BR2_PACKAGE_LINUX_FIRMWARE_IWLWIFI_22000
	select BR2_PACKAGE_LINUX_FIRMWARE_IWLWIFI_22260
	select BR2_PACKAGE_LINUX_FIRMWARE_IWLWIFI_3160
	select BR2_PACKAGE_LINUX_FIRMWARE_IWLWIFI_3168
	select BR2_PACKAGE_LINUX_FIRMWARE_IWLWIFI_3945
	select BR2_PACKAGE_LINUX_FIRMWARE_IWLWIFI_4965
	select BR2_PACKAGE_LINUX_FIRMWARE_IWLWIFI_5000
	select BR2_PACKAGE_LINUX_FIRMWARE_IWLWIFI_6000G2A
	select BR2_PACKAGE_LINUX_FIRMWARE_IWLWIFI_6000G2B
	select BR2_PACKAGE_LINUX_FIRMWARE_IWLWIFI_7260
	select BR2_PACKAGE_LINUX_FIRMWARE_IWLWIFI_7265
	select BR2_PACKAGE_LINUX_FIRMWARE_IWLWIFI_7265D
	select BR2_PACKAGE_LINUX_FIRMWARE_IWLWIFI_8000C
	select BR2_PACKAGE_LINUX_FIRMWARE_IWLWIFI_8265
	select BR2_PACKAGE_LINUX_FIRMWARE_IWLWIFI_9XXX
	select BR2_PACKAGE_LINUX_FIRMWARE_IWLWIFI_6E
	select BR2_PACKAGE_LINUX_FIRMWARE_IWLWIFI_7
	select BR2_PACKAGE_LINUX_FIRMWARE_IWLWIFI_QUZ
	select BR2_PACKAGE_LINUX_FIRMWARE_LIBERTAS_SD8686_V8
	select BR2_PACKAGE_LINUX_FIRMWARE_LIBERTAS_SD8686_V9
	select BR2_PACKAGE_LINUX_FIRMWARE_LIBERTAS_SD8688
	select BR2_PACKAGE_LINUX_FIRMWARE_LIBERTAS_USB8388_V9
	select BR2_PACKAGE_LINUX_FIRMWARE_LIBERTAS_USB8388_OLPC
	select BR2_PACKAGE_LINUX_FIRMWARE_LIBERTAS_USB_THINFIRM
	select BR2_PACKAGE_LINUX_FIRMWARE_MWIFIEX_SD8787
	select BR2_PACKAGE_LINUX_FIRMWARE_MWIFIEX_SD8797
	select BR2_PACKAGE_LINUX_FIRMWARE_MWIFIEX_USB8797
	select BR2_PACKAGE_LINUX_FIRMWARE_MWIFIEX_USB8801
	select BR2_PACKAGE_LINUX_FIRMWARE_MWIFIEX_SD8887
	select BR2_PACKAGE_LINUX_FIRMWARE_MWIFIEX_SD8897
	select BR2_PACKAGE_LINUX_FIRMWARE_MWIFIEX_USB8897
	select BR2_PACKAGE_LINUX_FIRMWARE_MWIFIEX_PCIE8897
	select BR2_PACKAGE_LINUX_FIRMWARE_MWIFIEX_PCIEUART8997
	select BR2_PACKAGE_LINUX_FIRMWARE_MWIFIEX_PCIEUSB8997
	select BR2_PACKAGE_LINUX_FIRMWARE_MEDIATEK_MT7601U
	select BR2_PACKAGE_LINUX_FIRMWARE_MEDIATEK_MT7610E
	select BR2_PACKAGE_LINUX_FIRMWARE_MEDIATEK_MT76X2E
	select BR2_PACKAGE_LINUX_FIRMWARE_MEDIATEK_MT7921
	select BR2_PACKAGE_LINUX_FIRMWARE_MEDIATEK_MT7922
	select BR2_PACKAGE_LINUX_FIRMWARE_MEDIATEK_MT7925
	select BR2_PACKAGE_LINUX_FIRMWARE_MEDIATEK_MT7986
	select BR2_PACKAGE_LINUX_FIRMWARE_QUALCOMM_6174
	select BR2_PACKAGE_LINUX_FIRMWARE_QUALCOMM_QCN9274
	select BR2_PACKAGE_LINUX_FIRMWARE_QUALCOMM_WCN7850
	select BR2_PACKAGE_LINUX_FIRMWARE_RALINK_RT61
	select BR2_PACKAGE_LINUX_FIRMWARE_RALINK_RT73
	select BR2_PACKAGE_LINUX_FIRMWARE_RALINK_RT2XX
	select BR2_PACKAGE_LINUX_FIRMWARE_RTL_81XX
	select BR2_PACKAGE_LINUX_FIRMWARE_RTL_87XX
	select BR2_PACKAGE_LINUX_FIRMWARE_RTL_88XX
	select BR2_PACKAGE_LINUX_FIRMWARE_RTL_RTW88
	select BR2_PACKAGE_LINUX_FIRMWARE_RTL_RTW89
	select BR2_PACKAGE_LINUX_FIRMWARE_REDPINE_RS9113
	select BR2_PACKAGE_LINUX_FIRMWARE_REDPINE_RS9116
	select BR2_PACKAGE_LINUX_FIRMWARE_TI_WL127X
	select BR2_PACKAGE_LINUX_FIRMWARE_TI_WL128X
	select BR2_PACKAGE_LINUX_FIRMWARE_TI_WL18XX
	select BR2_PACKAGE_LINUX_FIRMWARE_TI_CC33XX
	select BR2_PACKAGE_LINUX_FIRMWARE_QUALCOMM_WIL6210
	select BR2_PACKAGE_LINUX_FIRMWARE_BROADCOM_TIGON3
	select BR2_PACKAGE_LINUX_FIRMWARE_BNX2
	select BR2_PACKAGE_LINUX_FIRMWARE_BNX2X
	select BR2_PACKAGE_LINUX_FIRMWARE_CXGB4_T4
	select BR2_PACKAGE_LINUX_FIRMWARE_CXGB4_T5
	select BR2_PACKAGE_LINUX_FIRMWARE_CXGB4_T6
	select BR2_PACKAGE_LINUX_FIRMWARE_INTEL_E100
	select BR2_PACKAGE_LINUX_FIRMWARE_INTEL_ICE
	select BR2_PACKAGE_LINUX_FIRMWARE_MARVELL_PRESTERA
	select BR2_PACKAGE_LINUX_FIRMWARE_MICROCHIP_VSC85XX_PHY
	select BR2_PACKAGE_LINUX_FIRMWARE_QLOGIC_4X
	select BR2_PACKAGE_LINUX_FIRMWARE_RTL_815X
	select BR2_PACKAGE_LINUX_FIRMWARE_RTL_8169
	select BR2_PACKAGE_LINUX_FIRMWARE_AS102
	select BR2_PACKAGE_LINUX_FIRMWARE_DIB0700
	select BR2_PACKAGE_LINUX_FIRMWARE_ITETECH_IT9135
	select BR2_PACKAGE_LINUX_FIRMWARE_H5_DRXK
	select BR2_PACKAGE_LINUX_FIRMWARE_XCx000
	select BR2_PACKAGE_LINUX_FIRMWARE_QLOGIC_2XXX
	select BR2_PACKAGE_LINUX_FIRMWARE_QAT_DH895XCC
	select BR2_PACKAGE_LINUX_FIRMWARE_QAT_C3XXX
	select BR2_PACKAGE_LINUX_FIRMWARE_QAT_C62X
	select BR2_PACKAGE_LINUX_FIRMWARE_USB_SERIAL_TI
	select BR2_PACKAGE_LINUX_FIRMWARE_CX231XX
	select BR2_PACKAGE_LINUX_FIRMWARE_CX23885
	select BR2_PACKAGE_LINUX_FIRMWARE_INTEL_ATOMISP
	select BR2_PACKAGE_LINUX_FIRMWARE_ARM_MALI_CSF
	select BR2_PACKAGE_LINUX_FIRMWARE_POWERVR_ROGUE
	select BR2_PACKAGE_LINUX_FIRMWARE_RP2
	select BR2_PACKAGE_LINUX_FIRMWARE_INTEL_NPU
	help
	  Selects linux-firmware with every family it offers, for an image
	  whose drivers are all built in and whose machines are not known in
	  advance: bare metal and the hypervisor fleet.
```

## buildroot/package/embra-intel-microcode/Config.in
```kconfig
config BR2_PACKAGE_EMBRA_INTEL_MICROCODE
	bool "embra-intel-microcode"
	depends on BR2_x86_64
	depends on !BR2_PACKAGE_INTEL_MICROCODE
	help
	  Intel's processor microcode at the release embraOS pins: the
	  version in embra-intel-microcode.mk, the archive's sha256 in
	  the hash file beside it. The recipe leaves the files in the
	  images directory, where post_build.sh packs them into
	  /boot/ucode.cpio for the kernel's early loader, and installs
	  Intel's licence under /usr/share/licenses/intel-microcode.

	  Takes the place of Buildroot's intel-microcode package, whose
	  recipe names one release per Buildroot version; the two write
	  the same images directory, so only one is selected.

	  https://github.com/intel/Intel-Linux-Processor-Microcode-Data-Files
```

## buildroot/package/embra-update/Config.in
```kconfig
config BR2_PACKAGE_EMBRA_UPDATE
	bool "embra-update"
	help
	  embraOS backups and updates: snapshots of STATE and DATA, their
	  restore, and the signed release written into the inactive slot.
```
