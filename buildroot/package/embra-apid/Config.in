## buildroot/package/embra-apid/Config.in
```kconfig
config BR2_PACKAGE_EMBRA_APID
	bool "embra-apid"
	help
	  embraOS gRPC + REST API gateway.
```

## buildroot/package/embra-brain/Config.in
```kconfig
config BR2_PACKAGE_EMBRA_BRAIN
	bool "embra-brain"
	help
	  embraOS headless AI runtime service.
```

## buildroot/package/embra-comp/Config.in
```kconfig
config BR2_PACKAGE_EMBRA_COMP
	bool "embra-comp"
	help
	  embraOS Wayland kiosk compositor (single-fullscreen-client).
	  Built on smithay; hosts exactly one embra-desktop iced GUI
	  client per boot. Used in production tty-udev mode (DRM scanout
	  + libinput + seatd) when embraOS boots into a graphical
	  session. Requires the binary to be cross-compiled with
	  pkg-config pointing at Buildroot's staging tree so libudev /
	  libinput / libseat / libgbm / libdrm link against the rootfs
	  libs (not the host's musl-cross toolchain). See
	  scripts/build-image.sh for the staging-aware cargo invocation
	  (added in Stage 3c-final).
```

## buildroot/package/embra-console/Config.in
```kconfig
config BR2_PACKAGE_EMBRA_CONSOLE
	bool "embra-console"
	help
	  embraOS TUI client for serial console.
```

## buildroot/package/embra-desktop/Config.in
```kconfig
config BR2_PACKAGE_EMBRA_DESKTOP
	bool "embra-desktop"
	help
	  embraOS iced GUI client. Connects to embra-apid over gRPC and
	  renders the operator UI as a Wayland client of embra-comp's
	  fullscreen kiosk surface. Replaces embra-console in graphical
	  boots. The binary is cross-compiled against Buildroot's
	  staging tree (iced 0.14 pulls libwayland-client / xkbcommon /
	  softbuffer via FFI; the standalone musl.cc toolchain doesn't
	  ship those libs). Installed via the rootfs overlay in
	  scripts/build-image.sh Step 4.5.
```

## buildroot/package/embra-rust-toolchain/Config.in
```kconfig
config BR2_PACKAGE_EMBRA_RUST_TOOLCHAIN
	bool "embra-rust-toolchain"
	help
	  Prebaked Rust toolchain installed read-only at /opt/rust:
	  musl-host rustc + cargo + the wasm32-unknown-unknown std +
	  bundled rust-lld. Enables embra-guardian-v1 to compile
	  intelligence-authored dynamic tools to a wasmtime sandbox
	  at runtime (CARGO_HOME / target dir live on writable DATA).

	  Staged host-side by scripts/build-image.sh (Step 3.5) into
	  vendor/rust-toolchain. Adds substantial size to the rootfs.
```

## buildroot/package/embra-trustd/Config.in
```kconfig
config BR2_PACKAGE_EMBRA_TRUSTD
	bool "embra-trustd"
	help
	  embraOS PKI and soul verification service.
```

## buildroot/package/embra-web/Config.in
```kconfig
config BR2_PACKAGE_EMBRA_WEB
	bool "embra-web"
	help
	  embraOS self-hosted web console (HTTPS :3345) — enterprise
	  shell wrapping the real TUI in xterm.js over a PTY bridge.
```

## buildroot/package/embrad/Config.in
```kconfig
config BR2_PACKAGE_EMBRAD
	bool "embrad"
	help
	  embraOS PID 1 init and service supervisor.
```

## buildroot/package/wardsondb/Config.in
```kconfig
config BR2_PACKAGE_WARDSONDB
	bool "wardsondb"
	help
	  WardSONDB JSON document database for embraOS.
```

## embraOS_aarch64_AppleSilicon_Experimental_Build/embraos_aarch64_defconfig
```kconfig
# embraOS aarch64 Buildroot defconfig
# Base: QEMU virt (ARM64) — Apple Silicon native via HVF

BR2_aarch64=y
BR2_TOOLCHAIN_BUILDROOT_MUSL=y

# Kernel — ARM64 arch default config (covers virtio, ext4, squashfs, PL011 UART)
# NOTE: Cannot use BR2_LINUX_KERNEL_USE_DEFCONFIG here because Buildroot appends
# "_defconfig" to the value, producing the invalid "defconfig_defconfig".
# USE_ARCH_DEFAULT_CONFIG uses the architecture's default directly.
BR2_LINUX_KERNEL=y
BR2_LINUX_KERNEL_USE_ARCH_DEFAULT_CONFIG=y

# SquashFS support in kernel
BR2_LINUX_KERNEL_CONFIG_FRAGMENT_FILES="$(BR2_EXTERNAL_EMBRAOS_PATH)/board/embraos/linux.fragment"

# Filesystem — we build our own images
BR2_TARGET_ROOTFS_SQUASHFS=y
BR2_TARGET_ROOTFS_SQUASHFS4_XZ=y

# No default init — embrad is PID 1
BR2_INIT_NONE=y

# No default /etc skeleton
BR2_ROOTFS_SKELETON_DEFAULT=y

# Rootfs overlay (resolv.conf, mount points, workspace dir)
BR2_ROOTFS_OVERLAY="$(BR2_EXTERNAL_EMBRAOS_PATH)/board/embraos/rootfs_overlay"

# Post-build and post-image scripts
BR2_ROOTFS_POST_BUILD_SCRIPT="$(BR2_EXTERNAL_EMBRAOS_PATH)/board/embraos/post_build.sh"
BR2_ROOTFS_POST_IMAGE_SCRIPT="$(BR2_EXTERNAL_EMBRAOS_PATH)/board/embraos/post_image.sh"

# Image tools
BR2_PACKAGE_HOST_GENIMAGE=y
BR2_PACKAGE_HOST_MTOOLS=y

# OpenSSL + libcurl with TLS (required for git-remote-https)
BR2_PACKAGE_OPENSSL=y
BR2_PACKAGE_CA_CERTIFICATES=y
BR2_PACKAGE_LIBCURL=y
BR2_PACKAGE_LIBCURL_OPENSSL=y
BR2_PACKAGE_LIBCURL_CURL=y

# Git (15+ tools depend on this)
BR2_PACKAGE_GIT=y

# OpenSSH client only — NO server (security invariant)
BR2_PACKAGE_OPENSSH=y
BR2_PACKAGE_OPENSSH_CLIENT=y

# embraOS packages
BR2_PACKAGE_EMBRAD=y
BR2_PACKAGE_EMBRA_APID=y
BR2_PACKAGE_EMBRA_TRUSTD=y
BR2_PACKAGE_EMBRA_BRAIN=y
BR2_PACKAGE_EMBRA_CONSOLE=y
BR2_PACKAGE_WARDSONDB=y
```
