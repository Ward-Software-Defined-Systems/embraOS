## buildroot/package/embra-llama-cpp/Config.in
```kconfig
config BR2_PACKAGE_EMBRA_LLAMA_CPP
	bool "embra-llama-cpp"
	depends on BR2_INSTALL_LIBSTDCPP
	depends on BR2_TOOLCHAIN_HAS_THREADS
	depends on !BR2_STATIC_LIBS
	depends on !BR2_PACKAGE_LLAMA_CPP
	help
	  The model server of native models (experimental): llama.cpp's
	  llama-server at the release embraOS pins, the version in
	  embra-llama-cpp.mk and the archive's sha256 in the hash file
	  beside it. embrad keeps one running on loopback while the
	  operator asked for a native model, and the brain is its one
	  client.

	  The server alone is built: no command-line tool, no web page,
	  no TLS and no download code. The CPU backends are libraries
	  under /usr/lib/llama-cpp, one for each instruction set, and
	  the server loads the one the processor can run.

	  Takes the place of Buildroot's llama-cpp package, whose recipe
	  names an older build without these options; the two would
	  install the same libraries, so only one is selected.

	  https://github.com/ggml-org/llama.cpp
```

## buildroot/package/embra-mt7922-firmware/Config.in
```kconfig
config BR2_PACKAGE_EMBRA_MT7922_FIRMWARE
	bool "embra-mt7922-firmware"
	depends on BR2_PACKAGE_LINUX_FIRMWARE_MEDIATEK_MT7922
	help
	  The Wi-Fi firmware of MediaTek's MT7922 (the firmware and its
	  ROM patch) at the release of linux-firmware embraOS pins: the
	  version in embra-mt7922-firmware.mk, each file's sha256 in the
	  hash file beside it. The recipe installs the two files over
	  the ones of Buildroot's linux-firmware package, whose release
	  carries a file the kernel's driver refuses (the recipe's
	  comment has the account).

	  It goes when Buildroot's linux-firmware is 20251021 or later.

	  https://gitlab.com/kernel-firmware/linux-firmware
```
